## boards/board_l5_task1/Kconfig.board_l5_task1
```kconfig
# Copyright (c) 2016 BayLibre, SAS
# SPDX-License-Identifier: Apache-2.0

config BOARD_BOARD_L5_TASK1
	select SOC_STM32L476XX
```

## boards/board_l5_task1/board.yml
```yaml
board:
  name: board_l5_task1
  full_name: Board L5 Task1
  vendor: Alejandro Romio
  socs:
    - name: stm32l476xx
```

## boards/board_l5_task2/board.yml
```yaml
board:
  name: board_l5_task2
  full_name: Board L5 Task2
  vendor: Alejandro Romio
  socs:
    - name: stm32l476xx
```
